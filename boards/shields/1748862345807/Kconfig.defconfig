## boards/shields/1748862345807/Kconfig.defconfig
```kconfig
if SHIELD_1748862345807_RIGHT

config ZMK_KEYBOARD_NAME
    default "1748862345807"

endif

if SHIELD_1748862345807_LEFT || SHIELD_1748862345807_RIGHT

config ZMK_SPLIT
    default y

endif
```

## boards/shields/1748862345807/Kconfig.shield
```kconfig
config SHIELD_1748862345807_LEFT
    def_bool $(shields_list_contains,1748862345807_left)
config SHIELD_1748862345807_RIGHT
    def_bool $(shields_list_contains,1748862345807_right)
```
